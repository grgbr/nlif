## Config.in
```kconfig
################################################################################
# SPDX-License-Identifier: LGPL-3.0-only
#
# This file is part of nlif.
# Copyright (C) 2026 Grégor Boirie <gregor.boirie@free.fr>
################################################################################

mainmenu "NetLink InterFace build configuration"

config NLIF_ASSERT
	bool "Assertion"
	default n
	help
	  Build nlif with assertions enabled to perform full verification of
	  arguments consistency as well as internal state.

config NLIF_DEBUG
	bool "Debug"
	default n
	help
	  Build nlif in debug mode, enabling additional debugging messages,
	  additional internal state consistency checks as well as full memory
	  cleanup logic suitable for memory error detection tools such as
	  Valgrind's Memcheck and co.

config NLIF_LOG
	bool "Logging"
	default y
	help
	  Build nlif with support for logging messages.

config NLIF_PRINT
	bool "Object printing"
	default n
	help
	  Build nlif with support for displaying objects content on
	  console.

config NLIF_STORE
	bool "Object store"
	default n
	help
	  Build nlif with support for an object store that may serve as a
	  caching mechanism when coupled with asynchronous object notifications.

config NLIF_NOTIF
	bool "Notification"
	default n
	help
	  Build nlif with support for asynchronous object notifications.

config NLIF_DAEMON
	bool "nlifd daemon"
	select NLIF_NOTIF
	select NLIF_STORE
	default y
	help
	  Build the nlifd management daemon.

config NLIF_SAMPLE
	bool "Sample code"
	default n
	help
	  Build various sample code binaries showing how to use nlif internals.

config NLIF_SAMPLE_SHOW_IFACE
	bool "nlif-show-iface sample"
	depends on NLIF_SAMPLE
	select NLIF_STORE
	select NLIF_LOG
	default n
	help
	  Build the nlif-show-iface sample code that demonstrates how to
	  retrieve and display managed objects.

config NLIF_SAMPLE_SET_IFACE
	bool "nlif-set-iface sample"
	depends on NLIF_SAMPLE
	select NLIF_STORE
	select NLIF_LOG
	default n
	help
	  Build the nlif-set-iface sample code that demonstrates how to retrieve
	  and display managed objects.

config NLIF_SAMPLE_MON
	bool "nlif-mon sample"
	depends on NLIF_SAMPLE
	select NLIF_STORE
	select NLIF_NOTIF
	select NLIF_LOG
	default n
	help
	  Build the nlif-mon sample code that demonstrates how to retrieve and
	  monitor state changes of managed objets.

# ex: ft=kconfig:
```

## srepo/Config.in
```kconfig
################################################################################
# SPDX-License-Identifier: LGPL-3.0-only
#
# This file is part of nlif.
# Copyright (C) 2026 Grégor Boirie <gregor.boirie@free.fr>
################################################################################

config SREPO_ASSERT
	bool "Assertion"
	default n
	help
	  Build srepo with assertions enabled to perform full verification of
	  arguments consistency as well as internal state.

# ex: ft=kconfig:
```
